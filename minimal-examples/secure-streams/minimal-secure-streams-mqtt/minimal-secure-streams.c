/*
 * lws-minimal-secure-streams
 *
 * Written in 2010-2020 by Andy Green <andy@warmcat.com>
 *
 * This file is made available under the Creative Commons CC0 1.0
 * Universal Public Domain Dedication.
 *
 *
 * This demonstrates a minimal http client using secure streams api.
 *
 * It visits https://warmcat.com/ and receives the html page there.
 *
 * This is the "secure streams" api equivalent of minimal-http-client.
 *
 * See lws-minimal-secure-streams-seq for the same thing with a sequencer
 * integrated in above the secure stream.
 *
 * The layering looks like this
 *
 *                        lifetime
 *
 * ------   app   ------  process
 * --- secure stream ---  process
 * -------  wsi  -------  connection
 *
 * Use the -f switch to select a secure stream with a policy that misdirects
 * it to connect to the wrong port on the server, for testing the retry
 * handling.
 */
#include <libwebsockets.h>
#include <string.h>
#include <signal.h>

static FILE *file_ptr;
static int interrupted, bad = 1, is_proxy, just_once;
/*
 * We just define enough policy so it can fetch the latest one securely...
 * You can point it to any webserver, this uses
 *
 * https://warmcat.com/policy/minimal-proxy.json
 *
 * ... you can also visit it in a browser to see the JSON policy
 */

static const char * const default_ss_policy =
	"{"
	  "\"release\":"			"\"01234567\","
	  "\"product\":"			"\"myproduct\","
	  "\"schema-version\":"			"1,"
	  "\"retry\": ["	/* named backoff / retry strategies */
		"{\"default\": {"
			"\"backoff\": ["	 "1000,"
						 "2000,"
						 "3000,"
						 "5000,"
						"10000"
				"],"
			"\"conceal\":"		"5,"
			"\"jitterpc\":"		"20,"
			"\"svalidping\":"	"30,"
			"\"svalidhup\":"	"35"
		"}}"
	  "],"
	  "\"certs\": [" /* named individual certificates in BASE64 DER */
		/*
		 * Let's Encrypt certs for warmcat.com / libwebsockets.org
		 *
		 * We fetch the real policy from there using SS and switch to
		 * using that.
		 */
		"{\"isrg_root_x1\": \"" /* ISRG ROOT X1 */
	"MIIFazCCA1OgAwIBAgIRAIIQz7DSQONZRGPgu2OCiwAwDQYJKoZIhvcNAQELBQAw"
	"TzELMAkGA1UEBhMCVVMxKTAnBgNVBAoTIEludGVybmV0IFNlY3VyaXR5IFJlc2Vh"
	"cmNoIEdyb3VwMRUwEwYDVQQDEwxJU1JHIFJvb3QgWDEwHhcNMTUwNjA0MTEwNDM4"
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	"emyPxgcYxn/eR44/KJ4EBs+lVDR3veyJm+kXQ99b21/+jh5Xos1AnX5iItreGCc="
		"\"},"
		"{\"LEX3_isrg_root_x1\": \"" /* LE X3 signed by ISRG X1 root */
	"MIIFjTCCA3WgAwIBAgIRANOxciY0IzLc9AUoUSrsnGowDQYJKoZIhvcNAQELBQAw"
	"TzELMAkGA1UEBhMCVVMxKTAnBgNVBAoTIEludGVybmV0IFNlY3VyaXR5IFJlc2Vh"
	"cmNoIEdyb3VwMRUwEwYDVQQDEwxJU1JHIFJvb3QgWDEwHhcNMTYxMDA2MTU0MzU1"
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	"rUCGwbCUDI0mxadJ3Bz4WxR6fyNpBK2yAinWEsikxqEt"
		"\"}"
	  "],"
	  "\"trust_stores\": [" /* named cert chains */
		"{"
			"\"name\": \"le_via_isrg\","
			"\"stack\": ["
				"\"isrg_root_x1\","
				"\"LEX3_isrg_root_x1\""
			"]"
		"}"
	  "],"
	  "\"s\": ["
		"{\"fetch_policy\": {"
			"\"endpoint\":"		"\"warmcat.com\","
			"\"port\":"		"443,"
			"\"protocol\":"		"\"h1\","
			"\"http_method\":"	"\"GET\","
			"\"http_url\":"		"\"policy/minimal-proxy.json\","
			"\"tls\":"		"true,"
			"\"opportunistic\":"	"true,"
			"\"retry\":"		"\"default\","
			"\"tls_trust_store\":"	"\"le_via_isrg\""
		"}}"
	"}"
;

static const char *canned_root_token_payload =
	"grant_type=refresh_token"
	"&refresh_token=Atzr|IwEBIJedGXjDqsU_vMxykqOMg"
	"SHfYe3CPcedueWEMWSDMaDnEmiW8RlR1Kns7Cb4B-TOSnqp7ifVsY4BMY2B8tpHfO39XP"
	"zfu9HapGjTR458IyHX44FE71pWJkGZ79uVBpljP4sazJuk8XS3Oe_yLnm_DIO6fU1nU3Y"
	"0flYmsOiOAQE_gRk_pdlmEtHnpMA-9rLw3mkY5L89Ty9kUygBsiFaYatouROhbsTn8-jW"
	"k1zZLUDpT6ICtBXSnrCIg0pUbZevPFhTwdXd6eX-u4rq0W-XaDvPWFO7au-iPb4Zk5eZE"
	"iX6sissYrtNmuEXc2uHu7MnQO1hHCaTdIO2CANVumf-PHSD8xseamyh04sLV5JgFzY45S"
	"KvKMajiUZuLkMokOx86rjC2Hdkx5DO7G-dbG1ufBDG-N79pFMSs7Ck5pc283IdLoJkCQc"
	"AGvTX8o8I29QqkcGou-9TKhOJmpX8As94T61ok0UqqEKPJ7RhfQHHYdCtsdwxgvfVr9qI"
	"xL_hDCcTho8opCVX-6QhJHl6SQFlTw13"
	"&client_id="
		"amzn1.application-oa2-client.4823334c434b4190a2b5a42c07938a2d";

/*
 * This asn.1 DER was produced by
 *
 * $ cat 707f15c7fd-certificate.pem.crt | tail -n+2 | head -n-1 | base64 -d \
 *    hexdump -C | tr -s ' ' | sed "s/|.*\$//g" | cut -d' ' -f2-17 | \
 *    grep -v 000 | sed "s/\ /,\ 0x/g" | sed "s/^/0x/g" | sed "s/,\ 0x\$//g" | \
 *    sed "s/\$/,/g" | fold -s -w48
 *
 * It's 25% smaller than the PEM
 */

static const uint8_t client_cert_707f15c7fd_der[] = {
	0x30, 0x82, 0x03, 0x5a, 0x30, 0x82, 0x02, 0x42,
	0xa0, 0x03, 0x02, 0x01, 0x02, 0x02, 0x15, 0x00,
	0xeb, 0x74, 0xf6, 0xd4, 0xad, 0xd9, 0x8e, 0xea,
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	0x4a, 0x98, 0xa8, 0x7d, 0xe4, 0x28,

};

static const uint8_t client_key_707f15c7fd_der[] = {
	0x30, 0x82, 0x04, 0xa2, 0x02, 0x01, 0x00, 0x02,
	0x82, 0x01, 0x01, 0x00, 0xe0, 0x96, 0xeb, 0x92,
	0x93, 0x05, 0x67, 0xac, 0xfc, 0xa7, 0x81, 0x9a,
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	0x28, 0xf5, 0x66, 0x2f, 0xa1, 0x2d,

};

typedef struct myss {
	struct lws_ss_handle	*ss;
	void			*opaque_data;
	/* ... application specific state ... */
	lws_sorted_usec_list_t	sul;

	size_t			size;

	int			count;
	uint8_t			done_eom:1;
	uint8_t			time_to_send_something:1;
} myss_t;

static unsigned long
fsize(FILE *fp)
{
	int sz;

	fseek(fp, 0L, SEEK_END);
	sz=ftell(fp);
	fseek(fp, 0,SEEK_SET); /* go back to where we were */

	lwsl_user("%s file size = %d\n", __func__, (int) sz);
	return (unsigned long) sz;
}

/* secure streams payload interface */

static int
myss_rx(void *userobj, const uint8_t *buf, size_t len, int flags)
{
	myss_t *m = (myss_t *)userobj;

	lwsl_user("%s: ssh: %p, len %d, flags: %d\n", __func__, m->ss, (int)len, flags);
	lwsl_hexdump_notice(buf, len);

	return 0;
}

static int
myss_tx(void *userobj, lws_ss_tx_ordinal_t ord, uint8_t *buf, size_t *len,
	int *flags)
{
	myss_t *m = (myss_t *)userobj;
	size_t os = m->size;

	*flags = 0;

	if (!m->size && !m->time_to_send_something)
		return 1;

	m->time_to_send_something = 0;

	if (just_once && !file_ptr && m->done_eom == 1) {
		interrupted = 1;
		bad = 0;
		return 1;
	}

	if (!m->size)
		*flags = LWSSS_FLAG_SOM;

	if (!file_ptr) {
		*len = lws_snprintf((char *)buf, *len, "{\"unixtime\":%lu}",
				(unsigned long)lws_now_secs());

		*flags |= LWSSS_FLAG_EOM;
		m->size = 0;
	} else {

		/* send from file mode */

		m->size += *len = fread(buf, 1, *len, file_ptr);
		if ((*len < 1) || feof(file_ptr)) {
			*flags |= LWSSS_FLAG_EOM;
			m->done_eom = 1;
			m->size = 0;
		} else
			lws_ss_request_tx(m->ss); /* ask to send more ASAP */
	}

	lwsl_notice("%s: h: %p, sending %u - %u flags 0x%x\n", __func__, m->ss,
		    (unsigned int)os, (unsigned int)(os + *len), *flags);

	return 0;

	/* don't want to send anything */

	//return 1;
}

static void
sul_cb(lws_sorted_usec_list_t *sul)
{
	myss_t *m = (myss_t *)lws_container_of(sul, myss_t, sul);

	m->time_to_send_something = 1;
	if (file_ptr)
		lws_ss_request_tx_len(m->ss, fsize(file_ptr));
	else
		lws_ss_request_tx(m->ss);

	lws_sul_schedule(lws_ss_get_context(m->ss), 0, &m->sul, sul_cb,
			 3 * LWS_USEC_PER_SEC);
}

static int
myss_state(void *userobj, void *sh, lws_ss_constate_t state,
	   lws_ss_tx_ordinal_t ack)
{
	myss_t *m = (myss_t *)userobj;

	lwsl_user("%s: %p: %s, ord 0x%x\n", __func__, m->ss,
		  lws_ss_state_name(state), (unsigned int)ack);

	switch (state) {
	case LWSSSCS_CREATING:
		if (file_ptr)
			lws_ss_request_tx_len(m->ss, fsize(file_ptr));
		else
			lws_ss_request_tx(m->ss);
		break;

	case LWSSSCS_CONNECTED:
		m->size = 0;
		lws_sul_schedule(lws_ss_get_context(m->ss), 0, &m->sul, sul_cb,
				  1 * LWS_USEC_PER_SEC);
		break;
	case LWSSSCS_DISCONNECTED:
	case LWSSSCS_DESTROYING:
		lws_sul_schedule(lws_ss_get_context(m->ss), 0, &m->sul, sul_cb,
				 LWS_SET_TIMER_USEC_CANCEL);
		break;

	case LWSSSCS_ALL_RETRIES_FAILED:
		/* if we're out of retries, we want to close the app and FAIL */
		interrupted = 1;
		break;
	default:
		break;
	}

	return 0;
}


static int
system_notify_cb(lws_state_manager_t *mgr, lws_state_notify_link_t *link,
		   int current, int target)
{
	struct lws_context *context = mgr->parent;
	lws_system_blob_t *ab = lws_system_get_blob(context,
				LWS_SYSBLOB_TYPE_AUTH, 1 /* AUTH_IDX_ROOT */);
	lws_ss_info_t ssi;
	size_t size;

	if (current == LWS_SYSTATE_REGISTERED ||
	    target == LWS_SYSTATE_REGISTERED) {

		size = lws_system_blob_get_size(ab);
		if (size)
			return 0;

		/* let's register our canned root token so auth can use it */
		lws_system_blob_direct_set(ab,
				(const uint8_t *)canned_root_token_payload,
				strlen(canned_root_token_payload));
		return 0;
	}

	if (current != LWS_SYSTATE_OPERATIONAL || target != LWS_SYSTATE_OPERATIONAL)
		return 0;

	lwsl_notice("%s: operational\n", __func__);

	memset(&ssi, 0, sizeof(ssi));
	ssi.handle_offset = offsetof(myss_t, ss);
	ssi.opaque_user_data_offset = offsetof(myss_t, opaque_data);
	ssi.rx = myss_rx;
	ssi.tx = myss_tx;
	ssi.state = myss_state;
	ssi.user_alloc = sizeof(myss_t);

	ssi.streamtype = "mqtt_test";

	if (lws_ss_create(context, 0, &ssi, NULL, NULL, NULL, NULL)) {
		lwsl_err("%s: failed to create secure stream\n",
			 __func__);
		interrupted = 1;
		return 0;
	}

	if (!file_ptr) {
		ssi.streamtype = "mqtt_test1";

		if (lws_ss_create(context, 0, &ssi, NULL, NULL, NULL, NULL)) {
			lwsl_err("%s: failed to create secure stream 2\n",
				 __func__);
			interrupted = 1;
			return 0;
		}
	}

	return 0;
}

static void
sigint_handler(int sig)
{
	interrupted = 1;
}

int main(int argc, const char **argv)
{
	lws_state_notify_link_t notifier = { {}, system_notify_cb, "app" };
	lws_state_notify_link_t *na[] = { &notifier, NULL };
	struct lws_context_creation_info info;
	struct lws_context *context;
	int n = 0;
	const char *p;

	if ((p = lws_cmdline_option(argc, argv, "--file"))) {
		file_ptr = fopen(p, "r");
		if (file_ptr == NULL) {
			lwsl_err("Error opening file \"%s\"\n", p);
			return 1;
		}

		lwsl_user("File opened %p\n", file_ptr);
	}

	if (lws_cmdline_option(argc, argv, "--once"))
		just_once = 1;

	signal(SIGINT, sigint_handler);

	memset(&info, 0, sizeof info); /* otherwise uninitialized garbage */
	lws_cmdline_option_handle_builtin(argc, argv, &info);
	lwsl_user("LWS secure streams [-d<verb>] [-f] [-p] [--h1post]\n");
	lwsl_user("   [--file <path-to-send>] [--once]\n");

	info.options = LWS_SERVER_OPTION_EXPLICIT_VHOSTS |
		       LWS_SERVER_OPTION_DO_SSL_GLOBAL_INIT;
	info.fd_limit_per_thread = 1 + 6 + 1;
	info.pss_policies_json = default_ss_policy;
	info.register_notifier_list = na;
	info.port = CONTEXT_PORT_NO_LISTEN;
#if defined(LWS_WITH_DETAILED_LATENCY)
	info.detailed_latency_cb = lws_det_lat_plot_cb;
	info.detailed_latency_filepath = "/tmp/lws-latency-ssproxy";
#endif

	context = lws_create_context(&info);
	if (!context) {
		lwsl_err("lws init failed\n");
		return 1;
	}

	/* set up our device's client cert and key */

	lws_system_blob_direct_set(lws_system_get_blob(context,
		LWS_SYSBLOB_TYPE_CLIENT_CERT_DER, 0), client_cert_707f15c7fd_der,
			sizeof(client_cert_707f15c7fd_der));

	lws_system_blob_direct_set(lws_system_get_blob(context,
		LWS_SYSBLOB_TYPE_CLIENT_KEY_DER, 0), client_key_707f15c7fd_der,
			sizeof(client_key_707f15c7fd_der));

	if (lws_cmdline_option(argc, argv, "-p"))
		is_proxy = 1;

	/* the event loop */

	while (n >= 0 && !interrupted)
		n = lws_service(context, 0);

	if (file_ptr)
		fclose(file_ptr);

	lws_context_destroy(context);
	lwsl_user("Completed: %s\n", bad ? "failed" : "OK");

	return bad;
}
