/*
 * lws-api-test-gif
 *
 * Written in 2026 by Andy Green <andy@warmcat.com>
 *
 * This file is made available under the Creative Commons CC0 1.0
 * Universal Public Domain Dedication.
 *
 * Exercises the stateful GIF linewise decoder against a corpus generated by
 * an in-test GIF encoder, so the expected pixels are known by construction:
 * analytic grid comparisons in logical screen coordinates (background fill,
 * frame offset and clipping), interlace arrival order checks, palette and
 * transparency getters, byte-exact agreement between one-shot and
 * arbitrarily-chunked streaming decodes, restart equivalence, a hand-
 * computed golden vector, and robustness sweeps over truncations and
 * single-byte mutations.
 *
 * --dump <dir> additionally writes each corpus document and its decoded
 * raster as .gif / .ppm pairs for eyeballing.
 */

#include <libwebsockets.h>
#include <stdlib.h>
#include <string.h>
#include <stdio.h>
#include <fcntl.h>
#if !defined(WIN32) && !defined(_WIN32)
#include <unistd.h>
#endif

enum {
	LWS_SW_GIF,
	LWS_SW_OUT,
	LWS_SW_BG,
	LWS_SW_DUMP,
	LWS_SW_D,
	LWS_SW_HELP,

	EDICT_SIZE	= 1 << 13,	/* encoder string table slots */
	MAX_CASES	= 128,
	MAX_GRID	= 4 * 1024 * 1024, /* decode harness bitmap bound */
	EYEBALL_MAXDIM	= 8192,
	EYEBALL_MAXDOC	= 32 * 1024 * 1024,
};

static const struct lws_switches switches[] = {
	[LWS_SW_GIF]	= { "--gif",		"Decode this GIF file to a .bmp and exit" },
	[LWS_SW_OUT]	= { "--out",		"Output .bmp path (default <gif>.bmp)" },
	[LWS_SW_BG]	= { "--bg",		"Background rrggbb for compositing (default ffffff)" },
	[LWS_SW_DUMP]	= { "--dump",		"Directory to dump corpus gif+ppm into" },
	[LWS_SW_D]	= { "-d",		"Debug logs (e.g. -d 15)" },
	[LWS_SW_HELP]	= { "--help",		"Show this help information" },
};

static int checks, fails;
static const char *dumpdir;

#define CHK(_cond, _fmt, ...) do { \
	checks++; \
	if (!(_cond)) { \
		fails++; \
		lwsl_user("FAIL L%d: " _fmt "\n", __LINE__, ##__VA_ARGS__); \
	} \
} while (0)

static int
hexdigit(int c)
{
	if (c >= '0' && c <= '9')
		return c - '0';
	if (c >= 'a' && c <= 'f')
		return c - 'a' + 10;
	if (c >= 'A' && c <= 'F')
		return c - 'A' + 10;

	return -1;
}

/* ------------------------------------------------------------------ */
/* in-test GIF encoder: container + LZW, so expected pixels are known  */
/* ------------------------------------------------------------------ */

typedef struct {
	uint8_t		*out;			/* the gif document */
	size_t		outlen, outsize;
	uint8_t		*comp;			/* raw lzw byte stream */
	size_t		complen, compsize;

	/* the lzw state */

	uint32_t	ekey[EDICT_SIZE];	/* (prefix << 8) | suffix */
	int16_t		eval[EDICT_SIZE];
	uint32_t	bitacc;
	unsigned int	cwidth, next, clear, eoi, mcs;
	unsigned int	clear_every, since_clear;
	int		bitcnt;
} genc_t;

static int
buf_reserve(uint8_t **buf, size_t *size, size_t need)
{
	if (need <= *size)
		return 0;

	{
		size_t ns = *size ? *size * 2 : 1024;
		uint8_t *n;

		while (ns < need)
			ns *= 2;

		n = (uint8_t *)realloc(*buf, ns);
		if (!n)
			return 1;

		*buf = n;
		*size = ns;
	}

	return 0;
}

static int
ob(genc_t *g, uint8_t c)
{
	if (buf_reserve(&g->out, &g->outsize, g->outlen + 1))
		return 1;

	g->out[g->outlen++] = c;

	return 0;
}

static int
ou16(genc_t *g, unsigned int v)
{
	if (ob(g, (uint8_t)(v & 0xff)))
		return 1;

	return ob(g, (uint8_t)((v >> 8) & 0xff));
}

static int
cb(genc_t *g, uint8_t c)
{
	if (buf_reserve(&g->comp, &g->compsize, g->complen + 1))
		return 1;

	g->comp[g->complen++] = c;

	return 0;
}

static int
ocode(genc_t *g, unsigned int code)
{
	g->bitacc |= code << (unsigned int)g->bitcnt;
	g->bitcnt += (int)g->cwidth;

	while (g->bitcnt >= 8) {
		if (cb(g, (uint8_t)(g->bitacc & 0xff)))
			return 1;
		g->bitacc >>= 8;
		g->bitcnt -= 8;
	}

	return 0;
}

static int
oflush(genc_t *g)
{
	if (g->bitcnt) {
		if (cb(g, (uint8_t)(g->bitacc & 0xff)))
			return 1;
		g->bitacc = 0;
		g->bitcnt = 0;
	}

	return 0;
}

static unsigned int
ehash(uint32_t key)
{
	return (key * 2654435761u) >> (32 - 13);
}

static int
edict_find(genc_t *g, uint32_t key)
{
	unsigned int i = ehash(key) & (EDICT_SIZE - 1);

	while (g->eval[i] >= 0) {
		if (g->ekey[i] == key)
			return g->eval[i];
		i = (i + 1) & (EDICT_SIZE - 1);
	}

	return -1;
}

static void
edict_add(genc_t *g, uint32_t key, unsigned int code)
{
	unsigned int i = ehash(key) & (EDICT_SIZE - 1);

	while (g->eval[i] >= 0)
		i = (i + 1) & (EDICT_SIZE - 1);

	g->ekey[i] = key;
	g->eval[i] = (int16_t)code;
}

static void
elzw_reset(genc_t *g)
{
	memset(g->eval, -1, sizeof(g->eval));
	g->cwidth = g->mcs + 1;
	g->next = g->eoi + 1;
	g->since_clear = 0;
}

/*
 * Compress the pixel indices with LZW at min code size mcs, honoring the
 * forced-clear interval, into g->comp.  The table add and code width growth
 * match the decoder timeline entry for entry, including stopping adds at
 * 4096 without clearing (deferred clear).
 */

static int
elzw(genc_t *g, const uint8_t *idx, size_t n, unsigned int mcs)
{
	g->mcs = mcs;
	g->clear = 1u << mcs;
	g->eoi = g->clear + 1;
	g->bitacc = 0;
	g->bitcnt = 0;
	g->complen = 0;

	elzw_reset(g);

	if (ocode(g, g->clear))
		return 1;

	if (n) {
		unsigned int cur = idx[0];
		size_t i;

		for (i = 1; i < n; i++) {
			unsigned int k = idx[i];
			int hit = edict_find(g, (cur << 8) | k);

			if (hit >= 0) {
				cur = (unsigned int)hit;
				continue;
			}

			if (ocode(g, cur))
				return 1;

			if (g->next < 4096) {
				edict_add(g, (cur << 8) | k, g->next);
				g->next++;
				/*
				 * The decoder defines the entry one code
				 * later than the encoder does, so the width
				 * grows one code later here for the stream
				 * to stay in step
				 */
				if (g->next == (1u << g->cwidth) + 1 &&
				    g->cwidth < 12)
					g->cwidth++;
			}

			cur = k;

			if (g->clear_every &&
			    ++g->since_clear >= g->clear_every) {
				/* the pending string was just emitted: reset */

				if (ocode(g, g->clear))
					return 1;
				elzw_reset(g);
				cur = k;
			}
		}

		if (ocode(g, cur))
			return 1;
	}

	if (ocode(g, g->eoi) || oflush(g))
		return 1;

	return 0;
}

/* ------------------------------------------------------------------ */
/* decode-collection harness                                           */
/* ------------------------------------------------------------------ */

#define UNCOVERED 0xfe	/* grid cell no frame row covered */

typedef struct {
	unsigned int	w, h;
	uint8_t		*grid;		/* w*h indices */
	int		*order;		/* arrival order of row y */
	int		norder;
	unsigned int	rows;
	char		complete, fatal;

	/* getters observed once the decode produced its first row */

	unsigned int	pw, ph, pbpp, pcomps, pbits, ppsz;
	char		pinter;
	int		ptrans;
	unsigned int	ppalc;
	uint8_t		ppal[256 * 3];
} collect_t;

static void
collect_free(collect_t *c)
{
	free(c->grid);
	free(c->order);
	memset(c, 0, sizeof(*c));
}

static void
collect_getters(collect_t *c, lws_gif_t *gif)
{
	c->pw = lws_gif_get_width(gif);
	c->ph = lws_gif_get_height(gif);
	c->ppalc = lws_gif_get_palette_count(gif);
	if (c->ppalc)
		memcpy(c->ppal, lws_gif_get_palette(gif), c->ppalc * 3u);
	c->pinter = lws_gif_get_interlaced(gif);
	c->ptrans = lws_gif_get_transparent_index(gif);
	c->pbpp = lws_gif_get_bpp(gif);
	c->pcomps = lws_gif_get_components(gif);
	c->pbits = lws_gif_get_bitdepth(gif);
	c->ppsz = lws_gif_get_pixelsize(gif);
}

/*
 * Decode a whole gif document, feeding it in chunks of the given size.
 * Returns 0 if the decode ran to a defined end without FATAL.
 */

static int
decode_all(const uint8_t *data, size_t len, size_t chunk, collect_t *c)
{
	lws_gif_t *gif = lws_gif_new();
	size_t fed = 0;
	int ret = 0;

	memset(c, 0, sizeof(*c));

	if (!gif)
		return 1;

	for (;;) {
		const uint8_t *p = data + fed, *pix;
		size_t l = len - fed;
		lws_stateful_ret_t r;
		int py = -1;

		if (l > chunk)
			l = chunk;

		r = lws_gif_emit_next_line(gif, &pix, &py, &p, &l, 0);
		fed = (size_t)(p - data);

		if (r & LWS_SRET_FATAL) {
			c->fatal = 1;
			ret = 1;
			break;
		}

		if (r == LWS_SRET_WANT_OUTPUT) {
			if (!c->grid) {
				c->w = lws_gif_get_width(gif);
				c->h = lws_gif_get_height(gif);
				if (!c->w || !c->h ||
				    (size_t)c->w * c->h > MAX_GRID) {
					ret = 1;
					break;
				}
				c->grid = (uint8_t *)malloc(
						(size_t)c->w * c->h);
				c->order = (int *)malloc(
						sizeof(int) * (c->h + 1));
				if (!c->grid || !c->order) {
					ret = 1;
					break;
				}
				memset(c->grid, UNCOVERED,
				       (size_t)c->w * c->h);
				collect_getters(c, gif);
			}

			if ((unsigned int)py >= c->h) {
				ret = 1;
				break;
			}

			memcpy(&c->grid[(size_t)py * c->w], pix, c->w);
			c->order[c->norder++] = py;
			c->rows++;
			continue;
		}

		if (r == LWS_SRET_OK) {
			c->complete = 1;
			break;
		}

		/* LWS_SRET_WANT_INPUT */

		if (fed >= len)
			break;
	}

	if (!c->grid)
		collect_getters(c, gif);

	lws_gif_free(&gif);

	return ret;
}

/* ------------------------------------------------------------------ */
/* corpus cases                                                        */
/* ------------------------------------------------------------------ */

typedef struct {
	const char	*name;
	unsigned int	sw, sh;			/* logical screen */
	unsigned int	iw, ih, ileft, itop;	/* first image rect */
	unsigned int	ncolors;		/* power of two <= 256 */
	unsigned int	bgidx;
	char		interlaced;
	char		use_lct;		/* colour table on the image */
	char		gct_and_lct;		/* GCT present too, LCT differs */
	char		header87;
	char		no_trailer;
	unsigned int	extra_frames;
	int		trans;			/* -1 = none */
	unsigned int	chunk;			/* sub-block size */
	unsigned int	clear_every;		/* 0 = never */
	unsigned int	pattern;
	unsigned int	seed;
	char		exts;			/* extra extensions around */
} ccase_t;

static ccase_t corpus[MAX_CASES];
static int ncases;

static void dump_case(const ccase_t *cc, const uint8_t *doc, size_t len);

static void
add_case(const ccase_t *cc)
{
	if (ncases == MAX_CASES)
		return;
	corpus[ncases++] = *cc;
}

static void
fill_palette(uint8_t *pal, unsigned int n, unsigned int salt)
{
	unsigned int i;

	for (i = 0; i < n; i++) {
		pal[i * 3]     = (uint8_t)((i * 7 + salt) & 0xff);
		pal[i * 3 + 1] = (uint8_t)((i * 13 + 60 + salt) & 0xff);
		pal[i * 3 + 2] = (uint8_t)((i * 29 + 120 + salt) & 0xff);
	}
}

static void
gen_pixels(const ccase_t *cc, uint8_t *px)
{
	size_t n = (size_t)cc->iw * cc->ih, i;
	uint32_t s = 0x9e3779b9u ^ (cc->seed * 2654435761u);

	for (i = 0; i < n; i++) {
		unsigned int x = (unsigned int)(i % cc->iw);
		unsigned int y = (unsigned int)(i / cc->iw);

		switch (cc->pattern) {
		case 1:
			px[i] = (uint8_t)(x % cc->ncolors);
			break;
		case 2:
			s = s * 1103515245u + 12345u;
			px[i] = (uint8_t)((s >> 16) % cc->ncolors);
			break;
		case 3:
			/* alternating pair, bait for the KwKwK case */
			px[i] = (uint8_t)((i & 1) ? 1 : 0);
			break;
		case 4:
			px[i] = (uint8_t)(((x + 1) * (y + 1)) % cc->ncolors);
			break;
		default:
			px[i] = (uint8_t)((x + y) % cc->ncolors);
			break;
		}
	}
}

/* interlace pass starts and steps */

static const unsigned int ipstart[4] = { 0, 4, 2, 1 };
static const unsigned int ipstep[4] = { 8, 8, 4, 2 };

static int
encode_case(const ccase_t *cc, const uint8_t *px, uint8_t **pdoc,
	    size_t *plen, uint8_t *lct_pal, uint8_t *gct_pal)
{
	genc_t g;
	uint8_t pal[256 * 3];
	unsigned int mcs = 2, t;
	uint8_t *stream;
	size_t streamlen, i;
	unsigned int f;

	memset(&g, 0, sizeof(g));

	/*
	 * The colour table has 2^(bits+1) entries where bits is the packed
	 * size field; with a power-of-two palette that is just ncolors.
	 * The lzw minimum code size follows the alphabet, but is never
	 * less than 2 per the spec, so a 2-colour gif still uses mcs 2.
	 */

	t = 0;
	while ((2u << t) < cc->ncolors)
		t++;
	mcs = t + 1;
	if (mcs < 2)
		mcs = 2;	/* spec floor; the table size stays as it is */

	fill_palette(pal, cc->ncolors, 0);
	if (gct_pal)
		memcpy(gct_pal, pal, cc->ncolors * 3u);
	if (lct_pal)
		fill_palette(lct_pal, cc->ncolors, 90);

	/* header + logical screen descriptor */

	ob(&g, 'G');
	ob(&g, 'I');
	ob(&g, 'F');
	ob(&g, '8');
	ob(&g, cc->header87 ? '7' : '9');
	ob(&g, 'a');
	ou16(&g, cc->sw);
	ou16(&g, cc->sh);

	/* the lsd is always 7 bytes, table or not */

	ob(&g, (uint8_t)(cc->use_lct && !cc->gct_and_lct ?
				0 : (0x80 | t)));
	ob(&g, (uint8_t)cc->bgidx);
	ob(&g, 0);

	if (!(cc->use_lct && !cc->gct_and_lct))
		for (i = 0; i < cc->ncolors * 3u; i++)
			ob(&g, pal[i]);

	if (cc->exts) {
		/* a comment extension before any image */

		ob(&g, 0x21);
		ob(&g, 0xfe);
		ob(&g, 5);
		ob(&g, 'h');
		ob(&g, 'e');
		ob(&g, 'l');
		ob(&g, 'l');
		ob(&g, 'o');
		ob(&g, 0);
	}

	if (cc->trans >= 0) {
		/* graphic control extension for the first image */

		ob(&g, 0x21);
		ob(&g, 0xf9);
		ob(&g, 4);
		ob(&g, 1);			/* transparent flag */
		ou16(&g, 0);			/* delay */
		ob(&g, (uint8_t)cc->trans);
		ob(&g, 0);
	}

	/* pixel stream: rows in interlace order if interlaced */

	streamlen = (size_t)cc->iw * cc->ih;
	stream = (uint8_t *)malloc(streamlen);
	if (!stream)
		goto bail;

	if (cc->interlaced) {
		size_t o = 0;
		unsigned int pass, y;

		for (pass = 0; pass < 4; pass++)
			for (y = ipstart[pass]; y < cc->ih;
			     y += ipstep[pass]) {
				memcpy(stream + o, &px[(size_t)y * cc->iw],
				       cc->iw);
				o += cc->iw;
			}
	} else
		memcpy(stream, px, streamlen);

	for (f = 0; f < 1 + cc->extra_frames; f++) {

		if (f && cc->exts) {
			/* an application extension between images */

			ob(&g, 0x21);
			ob(&g, 0xff);
			ob(&g, 11);
			for (i = 0; i < 11; i++)
				ob(&g, (uint8_t)"NETSCAPE2.0"[i]);
			ob(&g, 3);
			ob(&g, 1);
			ou16(&g, 0);
			ob(&g, 0);
		}

		/* image descriptor */

		ob(&g, 0x2c);
		ou16(&g, cc->ileft);
		ou16(&g, cc->itop);
		ou16(&g, cc->iw);
		ou16(&g, cc->ih);
		ob(&g, (uint8_t)((cc->use_lct ? 0x80 | t : 0) |
				 (cc->interlaced ? 0x40 : 0)));

		if (cc->use_lct)
			for (i = 0; i < cc->ncolors * 3u; i++)
				ob(&g, lct_pal[i]);

		/* compressed data in sub-blocks */

		g.clear_every = cc->clear_every;
		if (elzw(&g, stream, streamlen, mcs))
			goto bail1;

		ob(&g, (uint8_t)mcs);

		{
			size_t cs = cc->chunk ? cc->chunk : 255;

			for (i = 0; i < g.complen; i += cs) {
				size_t n = g.complen - i;

				if (n > cs)
					n = cs;
				ob(&g, (uint8_t)n);
				if (buf_reserve(&g.out, &g.outsize,
						g.outlen + n))
					goto bail1;
				memcpy(g.out + g.outlen, g.comp + i, n);
				g.outlen += n;
			}
			ob(&g, 0);
		}
	}

	free(stream);
	free(g.comp);

	if (!cc->no_trailer)
		ob(&g, 0x3b);

	*pdoc = g.out;
	*plen = g.outlen;

	return 0;

bail1:
	free(stream);
	free(g.comp);
bail:
	free(g.out);

	return 1;
}

/*
 * Compute the expected logical-screen raster: background everywhere, with
 * clipped frame pixels inside the image rectangle.  Every screen row is
 * issued by the decoder exactly once, bg-filled where the image rectangle
 * does not reach.
 */

static void
build_expected(const ccase_t *cc, const uint8_t *px, uint8_t *exp)
{
	uint8_t bg = 0;
	unsigned int x, y;

	/* the same background-fill rule the decoder uses */

	if ((!cc->use_lct || cc->gct_and_lct) && cc->bgidx < cc->ncolors)
		bg = (uint8_t)cc->bgidx;

	memset(exp, bg, (size_t)cc->sw * cc->sh);

	for (y = 0; y < cc->ih; y++) {
		unsigned int sy = cc->itop + y;

		if (sy >= cc->sh)
			continue;

		for (x = 0; x < cc->sw; x++)
			if (x >= cc->ileft && x < cc->ileft + cc->iw)
				exp[(size_t)sy * cc->sw + x] =
					px[(size_t)y * cc->iw + (x - cc->ileft)];
	}
}

/*
 * The row arrival order the decoder promises: every screen row exactly
 * once; the bg rows above the image rectangle first, then the frame rows
 * top-down or in interlace pass order, then the bg rows below it.
 */

static void
expected_arrivals(const ccase_t *cc, int *ord, int *n)
{
	unsigned int y, pre, post;

	*n = 0;

	pre = cc->itop < cc->sh ? cc->itop : cc->sh;
	post = cc->itop + cc->ih > cc->sh ? 0 : cc->sh - cc->itop - cc->ih;

	for (y = 0; y < pre; y++)
		ord[(*n)++] = (int)y;

	if (cc->interlaced) {
		unsigned int pass;

		for (pass = 0; pass < 4; pass++)
			for (y = ipstart[pass]; y < cc->ih;
			     y += ipstep[pass]) {
				unsigned int sy = cc->itop + y;

				if (sy < cc->sh)
					ord[(*n)++] = (int)sy;
			}
	} else
		for (y = 0; y < cc->ih; y++) {
			unsigned int sy = cc->itop + y;

			if (sy < cc->sh)
				ord[(*n)++] = (int)sy;
		}

	for (y = cc->sh - post; y < cc->sh; y++)
		ord[(*n)++] = (int)y;
}

static void
check_collect(const ccase_t *cc, const collect_t *c, const uint8_t *exp,
	      const int *eord, int neord, const uint8_t *exp_pal)
{
	unsigned int i;

	CHK(c->fatal == 0, "%s: decode fatal", cc->name);
	CHK(c->complete == (cc->no_trailer ? 0 : 1),
	    "%s: complete %d", cc->name, c->complete);
	CHK(c->pw == cc->sw && c->ph == cc->sh, "%s: dims %ux%u",
	    cc->name, c->pw, c->ph);
	CHK(c->grid && !memcmp(c->grid, exp, (size_t)cc->sw * cc->sh),
	    "%s: grid mismatch", cc->name);
	CHK(c->norder == neord && c->rows == (unsigned int)neord,
	    "%s: %d rows, expected %d", cc->name, c->norder, neord);
	for (i = 0; i < (unsigned int)neord && i < (unsigned int)c->norder; i++)
		CHK(c->order[i] == eord[i], "%s: row %u arrived %d, expected %d",
		    cc->name, i, c->order[i], eord[i]);

	CHK(c->pinter == cc->interlaced, "%s: interlaced flag",
	    cc->name);
	CHK(c->ptrans == cc->trans, "%s: trans %d, expected %d",
	    cc->name, c->ptrans, cc->trans);
	CHK(c->ppalc == cc->ncolors, "%s: palette count %u",
	    cc->name, c->ppalc);
	CHK(exp_pal && !memcmp(c->ppal, exp_pal, cc->ncolors * 3u),
	    "%s: palette content", cc->name);
	CHK(c->pbpp == 8 && c->pbits == 8 && c->pcomps == 1 && c->ppsz == 8,
	    "%s: pixel geometry getters", cc->name);
}

static void
run_case(const ccase_t *cc)
{
	static const size_t chunks[] = { 1, 3, 7, (size_t)-1 };
	uint8_t *doc = NULL, *px = NULL, *exp = NULL, *eord = NULL;
	uint8_t lct_pal[256 * 3], gct_pal[256 * 3];
	const uint8_t *exp_pal;
	size_t len = 0;
	collect_t c;
	int neord, ci;

	px = (uint8_t *)malloc((size_t)cc->iw * cc->ih);
	exp = (uint8_t *)malloc((size_t)cc->sw * cc->sh);
	eord = (uint8_t *)malloc(sizeof(int) * (cc->sh + cc->ih + 1));

	if (!px || !exp || !eord) {
		CHK(0, "%s: OOM", cc->name);
		goto bail;
	}

	gen_pixels(cc, px);

	if (encode_case(cc, px, &doc, &len, lct_pal, gct_pal)) {
		CHK(0, "%s: encode", cc->name);
		goto bail;
	}

	build_expected(cc, px, exp);
	expected_arrivals(cc, (int *)eord, &neord);

	exp_pal = cc->use_lct ? lct_pal : gct_pal;

	for (ci = 0; ci < (int)LWS_ARRAY_SIZE(chunks); ci++) {
		size_t ch = chunks[ci] == (size_t)-1 ? len : chunks[ci];

		if (decode_all(doc, len, ch, &c)) {
			CHK(0, "%s: decode harness (chunk %zu)",
			    cc->name, ch);
			continue;
		}

		check_collect(cc, &c, exp, (const int *)eord, neord, exp_pal);
		collect_free(&c);
	}

	if (dumpdir)
		dump_case(cc, doc, len);

bail:
	free(doc);
	free(px);
	free(exp);
	free(eord);
}

/* ------------------------------------------------------------------ */
/* corpus                                                              */
/* ------------------------------------------------------------------ */

static void
build_corpus(void)
{
	static char namebuf[MAX_CASES][32];
	static const ccase_t base = {
		.name		= "",
		.sw = 8, .sh = 8, .iw = 8, .ih = 8,
		.ncolors	= 4,
		.trans		= -1,
		.chunk		= 255,
	};
	ccase_t cc;
	int namei = 0;

	/* one case per minimum code size, alphabet matching */

	{
		static const unsigned int ncs[] = { 2, 4, 8, 16, 32, 64, 128, 256 };
		size_t i;

		for (i = 0; i < LWS_ARRAY_SIZE(ncs); i++) {
			cc = base;
			cc.sw = cc.sh = cc.iw = cc.ih = 16;
			cc.ncolors = ncs[i];
			cc.pattern = 2;
			cc.seed = (unsigned int)i + 1;
			lws_snprintf(namebuf[namei], sizeof(namebuf[0]),
				     "mcs-alphabet-%u", ncs[i]);
			cc.name = namebuf[namei++];
			add_case(&cc);
		}
	}

	cc = base;
	cc.name = "basic-4col-8x8";
	add_case(&cc);

	cc = base;
	cc.name = "lct-only";
	cc.use_lct = 1;
	add_case(&cc);

	cc = base;
	cc.name = "gct-and-lct";
	cc.use_lct = 1;
	cc.gct_and_lct = 1;
	add_case(&cc);

	cc = base;
	cc.name = "transparent";
	cc.trans = 2;
	add_case(&cc);

	/* interlace: heights around the pass boundaries */

	{
		static const unsigned int hs[] = { 1, 2, 3, 4, 5, 8, 9, 16, 17 };
		size_t i;

		for (i = 0; i < LWS_ARRAY_SIZE(hs); i++) {
			cc = base;
			cc.sw = cc.iw = 13;
			cc.sh = cc.ih = hs[i];
			cc.interlaced = 1;
			cc.pattern = 4;
			lws_snprintf(namebuf[namei], sizeof(namebuf[0]),
				     "interlace-h%u", hs[i]);
			cc.name = namebuf[namei++];
			add_case(&cc);
		}
	}

	/* the same pixels progressive: grids must agree with interlaced */

	cc = base;
	cc.name = "interlace-equiv-progressive";
	cc.sw = cc.iw = 13;
	cc.sh = cc.ih = 17;
	cc.pattern = 4;
	add_case(&cc);

	/* frame offset inside a larger screen */

	cc = base;
	cc.name = "offset-frame";
	cc.sw = 20;
	cc.sh = 14;
	cc.iw = 10;
	cc.ih = 6;
	cc.ileft = 5;
	cc.itop = 3;
	add_case(&cc);

	/* frame hanging off the right and bottom of the screen */

	cc = base;
	cc.name = "clip-frame";
	cc.sw = 10;
	cc.sh = 10;
	cc.iw = 12;
	cc.ih = 12;
	cc.ileft = 6;
	cc.itop = 6;
	add_case(&cc);

	/* background fill, valid and out-of-range index */

	cc = base;
	cc.name = "bg-valid";
	cc.sw = 12;
	cc.sh = 9;
	cc.iw = 4;
	cc.ih = 9;
	cc.ileft = 8;
	cc.bgidx = 1;
	add_case(&cc);

	cc = base;
	cc.name = "bg-invalid";
	cc.sw = 12;
	cc.sh = 9;
	cc.iw = 4;
	cc.ih = 9;
	cc.ileft = 8;
	cc.bgidx = 200;
	add_case(&cc);

	/* forced clears keep the table tiny */

	cc = base;
	cc.name = "clear-every-3";
	cc.sw = cc.sh = cc.iw = cc.ih = 24;
	cc.clear_every = 3;
	add_case(&cc);

	cc = base;
	cc.name = "kwkwk";
	cc.sw = cc.iw = 32;
	cc.sh = cc.ih = 8;
	cc.pattern = 3;
	add_case(&cc);

	/* enough distinct substrings to fill the table: deferred clear */

	cc = base;
	cc.name = "table-saturation";
	cc.sw = cc.sh = cc.iw = cc.ih = 200;
	cc.ncolors = 256;
	cc.pattern = 2;
	cc.seed = 7;
	add_case(&cc);

	/* later images and extensions around them are walked, not decoded */

	cc = base;
	cc.name = "frames-3";
	cc.extra_frames = 2;
	cc.exts = 1;
	add_case(&cc);

	cc = base;
	cc.name = "extensions";
	cc.exts = 1;
	add_case(&cc);

	cc = base;
	cc.name = "gif87a";
	cc.header87 = 1;
	add_case(&cc);

	/* sub-block framing at the extremes */

	cc = base;
	cc.name = "subblocks-1";
	cc.sw = cc.sh = cc.iw = cc.ih = 12;
	cc.chunk = 1;
	add_case(&cc);

	cc = base;
	cc.name = "subblocks-2";
	cc.sw = cc.sh = cc.iw = cc.ih = 12;
	cc.chunk = 2;
	add_case(&cc);

	cc = base;
	cc.name = "subblocks-255";
	cc.sw = cc.sh = cc.iw = cc.ih = 12;
	cc.chunk = 255;
	add_case(&cc);

	/* narrow images make single strings span many rows */

	cc = base;
	cc.name = "tall-narrow-interlaced";
	cc.sw = cc.iw = 3;
	cc.sh = cc.ih = 64;
	cc.interlaced = 1;
	cc.pattern = 4;
	add_case(&cc);

	cc = base;
	cc.name = "tall-narrow-progressive";
	cc.sw = cc.iw = 3;
	cc.sh = cc.ih = 64;
	cc.pattern = 4;
	add_case(&cc);

	/* no trailer: rows still arrive, the document never completes */

	cc = base;
	cc.name = "no-trailer";
	cc.no_trailer = 1;
	add_case(&cc);
}

/* ------------------------------------------------------------------ */
/* selftest                                                            */
/* ------------------------------------------------------------------ */

/*
 * Hand-computed golden vector, independent of the encoder: a 2x2, 2-colour
 * gif with pixels 0,1 / 1,0.  Codes 4(clear),0,1,1 at 3 bits then 0,5(eoi)
 * at 4 bits (the table reached 8 entries), lsb-first packed, are
 * 0x44 0x02 0x05.
 */

static const uint8_t golden_lzw[3] = { 0x44, 0x02, 0x05 };

static size_t
mk_gif2(uint8_t *b, const uint8_t *lzwd, size_t l, uint8_t mcs)
{
	static const uint8_t hdr[] = {
		'G','I','F','8','9','a',
		2, 0, 2, 0,			/* 2x2 logical screen */
		0x80, 0, 0,			/* gct, 2 entries, bg 0 */
		0xff, 0xff, 0xff, 0, 0, 0,	/* white, black */
		0x2c,
		0, 0, 0, 0, 2, 0, 2, 0,		/* 2x2 image at 0,0 */
		0,
	};
	size_t o = 0;

	memcpy(b, hdr, sizeof(hdr));
	o = sizeof(hdr);
	b[o++] = mcs;
	b[o++] = (uint8_t)l;
	memcpy(b + o, lzwd, l);
	o += l;
	b[o++] = 0;
	b[o++] = 0x3b;

	return o;
}

static void
test_golden(void)
{
	uint8_t doc[64];
	collect_t c;
	size_t len;
	static const uint8_t expgrid[4] = { 0, 1, 1, 0 };
	const uint8_t *b;
	lws_gif_t *gif;
	size_t fed;

	len = mk_gif2(doc, golden_lzw, sizeof(golden_lzw), 2);

	CHK(decode_all(doc, len, len, &c) == 0, "golden: decode");
	CHK(!c.fatal && c.complete, "golden: completion");
	CHK(c.rows == 2 && c.norder == 2, "golden: rows");
	CHK(c.grid && !memcmp(c.grid, expgrid, 4), "golden: pixels");
	CHK(c.norder == 2 && c.order[0] == 0 && c.order[1] == 1,
	    "golden: arrival order");
	CHK(c.ptrans == -1, "golden: no transparency");
	CHK(c.ppalc == 2, "golden: palette count");
	CHK(c.ppalc == 2 && c.ppal[0] == 0xff && c.ppal[3] == 0,
	    "golden: palette content");
	collect_free(&c);

	/* chunked at every boundary: chunk 1 hits every split point */

	CHK(decode_all(doc, len, 1, &c) == 0, "golden: chunked decode");
	CHK(c.grid && !memcmp(c.grid, expgrid, 4) && c.rows == 2,
	    "golden: chunked equivalence");
	collect_free(&c);

	/* hold at metadata: dims after the lsd, before any decode state */

	gif = lws_gif_new();
	CHK(gif, "golden: OOM");
	if (!gif)
		return;

	b = doc;
	fed = 13;
	{
		size_t l = fed;
		const uint8_t *pix = (const uint8_t *)0x1;
		lws_stateful_ret_t r;

		r = lws_gif_emit_next_line(gif, &pix, NULL, &b, &l, 1);

		CHK(r == LWS_SRET_OK, "golden: hold ret 0x%x",
		    (unsigned int)r);
		CHK(l == 0, "golden: hold consumed %zu", l);
		CHK(lws_gif_get_width(gif) == 2 &&
		    lws_gif_get_height(gif) == 2, "golden: hold dims");
		CHK(pix == NULL, "golden: hold emitted a row");
	}

	/* further hold calls consume nothing */

	{
		size_t l = len - 13;
		const uint8_t *pix = NULL;

		b = doc + 13;
		CHK(lws_gif_emit_next_line(gif, &pix, NULL, &b, &l, 1) ==
							LWS_SRET_OK,
		    "golden: hold continue");
		CHK(l == len - 13, "golden: hold consumed more input");
		CHK(pix == NULL, "golden: hold emitted a row late");
	}

	/* continuing without hold decodes the whole document */

	{
		int py = -1, rows = 0;
		lws_stateful_ret_t r = LWS_SRET_WANT_INPUT;
		uint8_t grid[4];
		const uint8_t *pix;

		while (b < doc + len || r == LWS_SRET_WANT_OUTPUT) {
			size_t l = (size_t)(doc + len - b);

			pix = NULL;
			py = -1;
			r = lws_gif_emit_next_line(gif, &pix, &py, &b, &l, 0);
			if (r & LWS_SRET_FATAL)
				break;
			if (r == LWS_SRET_WANT_OUTPUT) {
				CHK(py >= 0 && py < 2, "golden: py %d", py);
				if (py >= 0 && py < 2) {
					memcpy(&grid[py * 2], pix, 2);
					rows++;
				}
			}
			if (r == LWS_SRET_OK)
				break;
			if (r == LWS_SRET_WANT_INPUT && !l)
				break;
		}

		CHK(r == LWS_SRET_OK, "golden: tail ret 0x%x",
		    (unsigned int)r);
		CHK(rows == 2 && !memcmp(grid, expgrid, 4),
		    "golden: tail decode");
	}

	/* restart and refeed: identical outcome, allocations kept */

	lws_gif_restart(gif);

	{
		int py, rows = 0, order[2];
		uint8_t grid[4];
		const uint8_t *pix;
		lws_stateful_ret_t r;

		b = doc;
		for (;;) {
			size_t l = (size_t)(doc + len - b);

			pix = NULL;
			py = -1;
			r = lws_gif_emit_next_line(gif, &pix, &py, &b, &l, 0);
			if (r & LWS_SRET_FATAL || r == LWS_SRET_OK)
				break;
			if (r == LWS_SRET_WANT_OUTPUT) {
				memcpy(&grid[py * 2], pix, 2);
				if (rows < 2)
					order[rows] = py;
				rows++;
			}
		}

		CHK(r == LWS_SRET_OK && rows == 2 &&
		    !memcmp(grid, expgrid, 4) && order[0] == 0 && order[1] == 1,
		    "golden: restart equivalence");
	}

	lws_gif_free(&gif);

	/* getters before any input */

	gif = lws_gif_new();
	CHK(gif, "golden: OOM 2");
	if (gif) {
		CHK(lws_gif_get_width(gif) == 0 &&
		    lws_gif_get_height(gif) == 0, "empty: dims");
		CHK(lws_gif_get_palette(gif) == NULL &&
		    lws_gif_get_palette_count(gif) == 0, "empty: palette");
		CHK(lws_gif_get_transparent_index(gif) == -1, "empty: trans");
		CHK(!lws_gif_get_interlaced(gif), "empty: interlace");
		lws_gif_free(&gif);
	}
}

/*
 * Interlaced and progressive encodings of the same pixels must produce the
 * same logical-screen raster.
 */

static void
test_interlace_equivalence(void)
{
	ccase_t cc;
	uint8_t *docp = NULL, *doci = NULL, *px = NULL;
	size_t lp = 0, li = 0;
	collect_t cp, ci;
	uint8_t lct[256 * 3], gct[256 * 3];

	memset(&cc, 0, sizeof(cc));
	cc.name = "equiv";
	cc.sw = cc.iw = 13;
	cc.sh = cc.ih = 17;
	cc.ncolors = 4;
	cc.trans = -1;
	cc.chunk = 255;
	cc.pattern = 4;

	px = (uint8_t *)malloc((size_t)cc.iw * cc.ih);
	if (!px) {
		CHK(0, "equiv: OOM");
		return;
	}
	gen_pixels(&cc, px);

	cc.interlaced = 0;
	if (encode_case(&cc, px, &docp, &lp, lct, gct)) {
		CHK(0, "equiv: encode progressive");
		goto bail;
	}
	cc.interlaced = 1;
	if (encode_case(&cc, px, &doci, &li, lct, gct)) {
		CHK(0, "equiv: encode interlaced");
		goto bail;
	}

	CHK(decode_all(docp, lp, 7, &cp) == 0, "equiv: progressive decode");
	CHK(decode_all(doci, li, 7, &ci) == 0, "equiv: interlaced decode");

	CHK(cp.grid && ci.grid && cp.w == ci.w && cp.h == ci.h &&
	    !memcmp(cp.grid, ci.grid, (size_t)cp.w * cp.h),
	    "equiv: rasters differ");

	/* the interlaced one must have arrived in interlace pass order */

	{
		int eord[17], neord, i;

		expected_arrivals(&cc, eord, &neord);
		CHK(ci.norder == neord, "equiv: interlaced row count");
		for (i = 0; i < neord && i < ci.norder; i++)
			CHK(ci.order[i] == eord[i],
			    "equiv: interlaced arrival %d", i);
	}

	collect_free(&cp);
	collect_free(&ci);

bail:
	free(docp);
	free(doci);
	free(px);
}

/* malformed inputs must be rejected with FATAL, never decoded */

static void
test_malformed(void)
{
	uint8_t doc[64], bad[64];
	collect_t c;
	size_t len;

	len = mk_gif2(doc, golden_lzw, sizeof(golden_lzw), 2);

	/* the decoder's golden vector must itself be well-formed */

	CHK(decode_all(doc, len, len, &c) == 0, "malformed: base case");
	collect_free(&c);

	/* broken header magic */

	memcpy(bad, doc, len);
	bad[0] = 'X';
	CHK(decode_all(bad, len, len, &c) != 0 && c.fatal,
	    "malformed: magic accepted");
	collect_free(&c);

	/* minimum code size out of range */

	memcpy(bad, doc, len);
	bad[29] = 1;
	CHK(decode_all(bad, len, len, &c) != 0 && c.fatal,
	    "malformed: mcs 1 accepted");
	collect_free(&c);

	memcpy(bad, doc, len);
	bad[29] = 9;
	CHK(decode_all(bad, len, len, &c) != 0 && c.fatal,
	    "malformed: mcs 9 accepted");
	collect_free(&c);

	/* unknown block introducer */

	memcpy(bad, doc, len);
	bad[19] = 0x99;
	CHK(decode_all(bad, len, len, &c) != 0 && c.fatal,
	    "malformed: introducer accepted");
	collect_free(&c);

	/* degenerate logical screen */

	memcpy(bad, doc, len);
	bad[6] = 0;
	bad[7] = 0;
	CHK(decode_all(bad, len, len, &c) != 0 && c.fatal,
	    "malformed: zero width accepted");
	collect_free(&c);

	/* degenerate image rectangle */

	memcpy(bad, doc, len);
	bad[24] = 0;
	bad[25] = 0;
	CHK(decode_all(bad, len, len, &c) != 0 && c.fatal,
	    "malformed: zero image width accepted");
	collect_free(&c);

	/*
	 * Hand-built code streams: after a clear, the first code must be a
	 * root (6 here is the first free slot), and codes cannot reference
	 * entries that do not exist yet (7 with next at 6).
	 */

	{
		static const uint8_t notroot[2] = { 0x74, 0x01 };
		static const uint8_t beyond[2] = { 0x7c, 0x01 };

		len = mk_gif2(doc, notroot, sizeof(notroot), 2);
		CHK(decode_all(doc, len, len, &c) != 0 && c.fatal,
		    "malformed: first code not a root accepted");
		collect_free(&c);

		len = mk_gif2(doc, beyond, sizeof(beyond), 2);
		CHK(decode_all(doc, len, len, &c) != 0 && c.fatal,
		    "malformed: code beyond table accepted");
		collect_free(&c);

		len = mk_gif2(doc, golden_lzw, sizeof(golden_lzw), 2);
	}

	/* graphic control extension with the wrong block size */

	{
		static const uint8_t gce[] = {
			0x21, 0xf9, 0x05, 1, 0, 0, 0, 0, 0,
		};
		uint8_t bad2[96];
		size_t o = 0, l;

		memcpy(bad2, doc, 13); /* header + lsd */
		memcpy(bad2 + 13, doc + 13, 6); /* gct */
		memcpy(bad2 + 19, gce, sizeof(gce));
		o = 19 + sizeof(gce);
		memcpy(bad2 + o, doc + 19, len - 19);
		l = o + len - 19;

		CHK(decode_all(bad2, l, l, &c) != 0 && c.fatal,
		    "malformed: gce size accepted");
		collect_free(&c);
	}

	/* truncations: every prefix is a defined outcome, never a hang */

	{
		size_t cut;

		for (cut = 0; cut < len; cut++) {
			decode_all(doc, cut, cut, &c);
			/* any defined result is fine */
			collect_free(&c);
		}
		checks++;	/* the sweep as a whole is one check */
	}

	/*
	 * Deterministic single-byte mutations over a corpus document with a
	 * filled table: no crash, no hang, and rows are in range or FATAL
	 */

	{
		ccase_t cc;
		uint8_t *doc2 = NULL, *px, lct[256 * 3], gct[256 * 3];
		size_t l2 = 0, i;
		uint32_t seed = 0x12345678;

		memset(&cc, 0, sizeof(cc));
		cc.name = "mut";
		cc.sw = cc.sh = cc.iw = cc.ih = 24;
		cc.ncolors = 16;
		cc.trans = -1;
		cc.chunk = 9;
		cc.pattern = 2;
		cc.seed = 3;

		px = (uint8_t *)malloc((size_t)cc.iw * cc.ih);
		if (!px) {
			CHK(0, "mut: OOM");
			return;
		}
		gen_pixels(&cc, px);
		if (encode_case(&cc, px, &doc2, &l2, lct, gct)) {
			CHK(0, "mut: encode");
			free(px);
			return;
		}
		free(px);

		for (i = 0; i < 1500; i++) {
			seed = seed * 1103515245u + 12345u;
			doc2[seed % l2] = (uint8_t)(seed >> 16);
			decode_all(doc2, l2, 13, &c);
			collect_free(&c);
		}
		free(doc2);
		checks++;
	}
}

/*
 * Several live gif objects share one emit buffer: a row from one object is
 * at the same address a row from another object was, and interleaved
 * decodes stay correct.  This is the property the dlo page rendering
 * depends on.
 */

static void
test_shared_row_pool(void)
{
	ccase_t cc;
	uint8_t *doc = NULL, *px = NULL, lct[256 * 3], gct[256 * 3];
	size_t len = 0;
	lws_gif_t *gifs[4];
	const uint8_t *pix, *first = NULL;
	int py, i, rows[4];
	lws_stateful_ret_t r;

	memset(&cc, 0, sizeof(cc));
	cc.name = "pool";
	cc.sw = cc.iw = 16;
	cc.sh = cc.ih = 16;
	cc.ncolors = 4;
	cc.trans = -1;
	cc.chunk = 255;
	cc.pattern = 0;

	px = (uint8_t *)malloc((size_t)cc.iw * cc.ih);
	if (!px) {
		CHK(0, "pool: OOM");
		return;
	}
	gen_pixels(&cc, px);
	if (encode_case(&cc, px, &doc, &len, lct, gct)) {
		CHK(0, "pool: encode");
		goto bail;
	}

	for (i = 0; i < 4; i++) {
		gifs[i] = lws_gif_new();
		if (!gifs[i]) {
			CHK(0, "pool: OOM gif");
			while (i--)
				lws_gif_free(&gifs[i]);
			goto bail;
		}
	}

	/* interleave one row at a time from each object in strict rotation */

	memset(rows, 0, sizeof(rows));
	for (py = 0; py < 16; py++) {
		for (i = 0; i < 4; i++) {
			const uint8_t *b = doc;
			size_t remain = len;
			int got = -1;

			/*
			 * Restart each object each time: the point here is
			 * the shared buffer and interleaving, not cursor
			 * persistence
			 */

			lws_gif_restart(gifs[i]);

			while (remain) {
				size_t l = remain;
				int ry = -1;

				pix = NULL;
				r = lws_gif_emit_next_line(gifs[i], &pix, &ry,
							   &b, &l, 0);
				remain = (size_t)(doc + len - b);

				CHK(!(r & LWS_SRET_FATAL),
				    "pool: fatal on object %d", i);
				if (r & LWS_SRET_FATAL)
					goto done;

				if (r == LWS_SRET_WANT_OUTPUT) {
					if (ry == py) {
						/* the row we wanted */

						if (px[(size_t)py * 16] ==
								pix[0])
							got = 1;
						else
							got = 0;
						if (!first)
							first = pix;
						else
							CHK(pix == first,
							    "pool: rows not "
							    "sharing buffer");
						break;
					}
					continue;
				}
				if (r == LWS_SRET_OK)
					break;
			}

			CHK(got == 1, "pool: object %d row %d wrong", i, py);
			rows[i]++;
		}
	}

done:
	for (i = 0; i < 4; i++)
		lws_gif_free(&gifs[i]);

bail:
	free(doc);
	free(px);
}

/* ------------------------------------------------------------------ */
/* dump and eyeball modes                                              */
/* ------------------------------------------------------------------ */

static void
write_ppm(const char *path, const collect_t *c)
{
	static uint8_t row[8192 * 3];
	const uint8_t *pal = c->ppal;
	int fd = lws_open(path, LWS_O_WRONLY | LWS_O_CREAT | LWS_O_TRUNC, 0644);
	unsigned int x, y;
	uint8_t hdr[64];
	int n;

	if (fd < 0)
		return;

	n = lws_snprintf((char *)hdr, sizeof(hdr), "P6\n%u %u\n255\n",
			 c->w, c->h);
	if (write(fd, hdr, (size_t)n) < 0)
		lwsl_err("%s: write failed\n", __func__);

	for (y = 0; y < c->h; y++) {

		for (x = 0; x < c->w && x * 3u + 2u < sizeof(row); x++) {
			uint8_t idx = c->grid[(size_t)y * c->w + x];

			if (idx == UNCOVERED || idx >= c->ppalc) {
				row[x * 3] = 0x80;
				row[x * 3 + 1] = 0x80;
				row[x * 3 + 2] = 0x80;
			} else {
				row[x * 3]     = pal[idx * 3];
				row[x * 3 + 1] = pal[idx * 3 + 1];
				row[x * 3 + 2] = pal[idx * 3 + 2];
			}
		}

		if (write(fd, row, (size_t)c->w * 3) < 0)
			lwsl_err("%s: write failed\n", __func__);
	}

	close(fd);
}

static void
dump_case(const ccase_t *cc, const uint8_t *doc, size_t len)
{
	char path[300];
	collect_t c;
	int fd;

	lws_snprintf(path, sizeof(path), "%s/%s.gif", dumpdir, cc->name);
	fd = lws_open(path, LWS_O_WRONLY | LWS_O_CREAT | LWS_O_TRUNC, 0644);
	if (fd >= 0) {
		if (write(fd, doc, len) < (ssize_t)len)
			lwsl_err("%s: write failed\n", __func__);
		close(fd);
	}

	if (decode_all(doc, len, 1, &c))
		return;

	lws_snprintf(path, sizeof(path), "%s/%s.ppm", dumpdir, cc->name);
	write_ppm(path, &c);

	collect_free(&c);
}

static void
write_bmp_header(int fd, int w, int h)
{
	uint8_t head[54];
	int filesize = 54 + ((((w * 3) + 3) & ~3)) * h;

	memset(head, 0, sizeof(head));

	head[0] = 'B';
	head[1] = 'M';
	head[2] = (uint8_t)(filesize & 0xff);
	head[3] = (uint8_t)((filesize >> 8) & 0xff);
	head[4] = (uint8_t)((filesize >> 16) & 0xff);
	head[5] = (uint8_t)((filesize >> 24) & 0xff);
	head[10] = 54;

	head[14] = 40;
	head[18] = (uint8_t)(w & 0xff);
	head[19] = (uint8_t)((w >> 8) & 0xff);
	head[20] = (uint8_t)((w >> 16) & 0xff);
	head[21] = (uint8_t)((w >> 24) & 0xff);

	h = -h; /* top-down */
	head[22] = (uint8_t)(h & 0xff);
	head[23] = (uint8_t)((h >> 8) & 0xff);
	head[24] = (uint8_t)((h >> 16) & 0xff);
	head[25] = (uint8_t)((h >> 24) & 0xff);

	head[26] = 1;
	head[28] = 24;

	if (write(fd, head, 54) < 54)
		lwsl_err("%s: write failed\n", __func__);
}

static int
eyeball(const char *inpath, const char *outpath, uint32_t bg)
{
	uint8_t bgr[3] = { (uint8_t)(bg & 0xff), (uint8_t)((bg >> 8) & 0xff),
			   (uint8_t)((bg >> 16) & 0xff) };
	uint8_t *doc, pad[3] = { 0, 0, 0 };
	size_t len = 0;
	ssize_t n;
	collect_t c;
	int fd, outfd, y, padlen, ret = 1;

	fd = lws_open(inpath, LWS_O_RDONLY, 0);
	if (fd < 0) {
		lwsl_user("%s: unable to open %s\n", __func__, inpath);
		return 1;
	}

	doc = (uint8_t *)malloc(EYEBALL_MAXDOC);
	if (!doc)
		goto bail1;

	while (len < EYEBALL_MAXDOC) {
		n = read(fd, doc + len, EYEBALL_MAXDOC - len);
		if (n < 0) {
			lwsl_user("%s: read failed\n", __func__);
			goto bail2;
		}
		if (!n)
			break;
		len += (size_t)n;
	}
	if (len == EYEBALL_MAXDOC) {
		lwsl_user("%s: %s too large\n", __func__, inpath);
		goto bail2;
	}
	close(fd);
	fd = -1;

	if (decode_all(doc, len, 4096, &c)) {
		lwsl_user("%s: decode failed\n", __func__);
		goto bail2;
	}

	lwsl_user("%s: %zu bytes, %ux%u, %u rows, interlaced %d, "
		  "%u palette entries, transparent %d\n", __func__, len,
		  c.pw, c.ph, c.rows, c.pinter, c.ppalc, c.ptrans);

	if (!c.w || !c.h || c.w > EYEBALL_MAXDIM || c.h > EYEBALL_MAXDIM) {
		lwsl_user("%s: no usable raster\n", __func__);
		goto bail3;
	}

	outfd = lws_open(outpath, LWS_O_WRONLY | LWS_O_CREAT | LWS_O_TRUNC,
									0644);
	if (outfd < 0) {
		lwsl_user("%s: unable to open %s\n", __func__, outpath);
		goto bail3;
	}

	write_bmp_header(outfd, (int)c.w, (int)c.h);

	padlen = (4 - ((int)c.w * 3 & 3)) & 3;

	for (y = 0; y < (int)c.h; y++) {
		uint8_t *row = (uint8_t *)malloc((size_t)c.w * 3);
		unsigned int x;

		if (!row) {
			lwsl_user("%s: OOM\n", __func__);
			break;
		}

		for (x = 0; x < c.w; x++) {
			uint8_t idx = c.grid[(size_t)y * c.w + x];
			uint8_t *p = &row[x * 3];

			p[0] = bgr[0];
			p[1] = bgr[1];
			p[2] = bgr[2];

			if (idx != UNCOVERED && (int)idx != c.ptrans &&
			    idx < c.ppalc) {
				p[0] = c.ppal[idx * 3];
				p[1] = c.ppal[idx * 3 + 1];
				p[2] = c.ppal[idx * 3 + 2];
			}
		}

		if (write(outfd, row, (size_t)c.w * 3) < 0 ||
		    (padlen && write(outfd, pad, (size_t)padlen) < 0))
			lwsl_err("%s: write failed\n", __func__);

		free(row);
	}

	ret = 0;

	close(outfd);
bail3:
	collect_free(&c);
bail2:
	free(doc);
bail1:
	if (fd >= 0)
		close(fd);

	return ret;
}

/* ------------------------------------------------------------------ */

int
main(int argc, const char **argv)
{
	int i, result;
	const char *p;

	if (lws_cmdline_option(argc, argv, switches[LWS_SW_HELP].sw)) {
		lws_switches_print_help(argv[0], switches,
					LWS_ARRAY_SIZE(switches));
		return 0;
	}

	lws_set_log_level(LLL_USER | LLL_NOTICE, NULL);

	if ((p = lws_cmdline_option(argc, argv, switches[LWS_SW_D].sw)))
		lws_set_log_level(atoi(p), NULL);

	/* eyeball mode: decode a single gif file to a .bmp */

	if ((p = lws_cmdline_option(argc, argv, switches[LWS_SW_GIF].sw))) {
		const char *out = lws_cmdline_option(argc, argv,
						switches[LWS_SW_OUT].sw);
		const char *bgs = lws_cmdline_option(argc, argv,
						switches[LWS_SW_BG].sw);
		char tmp[300];
		uint32_t bg = 0xffffff;

		if (bgs && strlen(bgs) == 6) {
			bg = 0;
			for (i = 0; i < 6; i++) {
				int h = hexdigit(bgs[i]);

				if (h < 0)
					break;
				bg = (bg << 4) | (uint32_t)h;
			}
			if (i != 6)
				bg = 0xffffff;
		}

		if (!out) {
			lws_snprintf(tmp, sizeof(tmp), "%s.bmp", p);
			out = tmp;
		}

		return eyeball(p, out, bg);
	}

	if ((p = lws_cmdline_option(argc, argv, switches[LWS_SW_DUMP].sw)))
		dumpdir = p;

	lwsl_user("LWS GIF corpus test tool\n");

	build_corpus();
	lwsl_user("corpus: %d documents\n", ncases);

	for (i = 0; i < ncases; i++)
		run_case(&corpus[i]);

	test_golden();
	test_interlace_equivalence();
	test_malformed();
	test_shared_row_pool();

	result = fails ? 1 : 0;

	lwsl_user("%s: %d checks, %d failures\n", argv[0], checks, fails);

	return result;
}
